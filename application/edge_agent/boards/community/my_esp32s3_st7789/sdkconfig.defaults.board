## application/edge_agent/sdkconfig.defaults
```kconfig
# Partition table (8MB)
CONFIG_PARTITION_TABLE_CUSTOM=y
CONFIG_PARTITION_TABLE_CUSTOM_FILENAME="partitions_8MB.csv"
CONFIG_PARTITION_TABLE_OFFSET=0x9000
```
